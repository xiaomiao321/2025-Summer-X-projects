/* USER CODE BEGIN Header */
/**
  ******************************************************************************
  * @file           : main.c
  * @brief          : Main program body
  ******************************************************************************
  * @attention
  *
  * Copyright (c) 2024 STMicroelectronics.
  * All rights reserved.
  *
  * This software is licensed under terms that can be found in the LICENSE file
  * in the root directory of this software component.
  * If no LICENSE file comes with this software, it is provided AS-IS.
  *
  ******************************************************************************
  */
/* USER CODE END Header */
/* Includes ------------------------------------------------------------------*/
#include "main.h"
#include "gpio.h"

/* Private includes ----------------------------------------------------------*/
/* USER CODE BEGIN Includes */
#include "OLED.h"
/* USER CODE END Includes */

/* Private typedef -----------------------------------------------------------*/
/* USER CODE BEGIN PTD */

/* USER CODE END PTD */

/* Private define ------------------------------------------------------------*/
/* USER CODE BEGIN PD */
#define MODE 2  // range: 0, 1, 2
/* USER CODE END PD */

/* Private macro -------------------------------------------------------------*/
/* USER CODE BEGIN PM */

/* USER CODE END PM */

/* Private variables ---------------------------------------------------------*/

/* USER CODE BEGIN PV */

/* USER CODE END PV */

/* Private function prototypes -----------------------------------------------*/
void SystemClock_Config(void);
/* USER CODE BEGIN PFP */

/* USER CODE END PFP */

/* Private user code ---------------------------------------------------------*/
/* USER CODE BEGIN 0 */


const unsigned char battery_outline []  = {
		0xfc, 0xfe, 0x7, 0x3, 0x3, 0x3, 0x3, 0x3, 0x3, 0x3, 0x3, 0x3,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 0x0,
		0xff, 0xff, 0x0, 0x0, 0x0, 0x0, 0x0, 0x0, 0x0, 0x0, 0x0, 0x0,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 0xe0,
		0xff, 0xff, 0x0, 0x0, 0x0, 0x0, 0x0, 0x0, 0x0, 0x0, 0x0, 0x0,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 0xff,
		0xff, 0xff, 0x0, 0x0, 0x0, 0x0, 0x0, 0x0, 0x0, 0x0, 0x0, 0x0,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 0x7,
		0x3f, 0x7f, 0xe0, 0xc0, 0xc0, 0xc0, 0xc0, 0xc0, 0xc0, 0xc0, 0xc0, 0xc0,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 0x0,
};


const unsigned char water_array[30][128] = {
		0xfe, 0x0, 0x0, 0x0, 0x0, 0x0, 0x0, 0x0, 0x0, 0x0, 0x0, 0x0, 0x0, 0x0, 0x0, 0x0, 0x0, 0x0, 0x0, 0x0, 0x0, 0x0, 0x0, 0x0, 0x0, 0x0, 0x0, 0x0, 0x0, 0x0, 0x0, 0x0,
		0xff, 0x0, 0x0, 0x0, 0x0, 0x0, 0x0, 0x0, 0x0, 0x0, 0x0, 0x0, 0x0, 0x0, 0x0, 0x0, 0x0, 0x0, 0x0, 0x0, 0x0, 0x0, 0x0, 0x0, 0x0, 0x0, 0x0, 0x0, 0x0, 0x0, 0x0, 0x0,
		0xff, 0xfe, 0xfc, 0xf8, 0xf0, 0xf0, 0xe0, 0xc0, 0xc0, 0x0, 0x0, 0x0, 0x0, 0x0, 0x0, 0xc, 0x1e, 0x1e, 0x1e, 0x1c, 0x0, 0x0, 0x0, 0x0, 0x0, 0x0, 0x0, 0x0, 0x0, 0x0, 0x0, 0x0,
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		0xff, 0xff, 0xff, 0xff, 0x7f, 0x7f, 0x3f, 0x3f, 0x1f, 0x1f, 0xf, 0x0, 0x0, 0x0, 0x0, 0x0, 0x0, 0x0, 0x0, 0x0, 0x0, 0x0, 0x0, 0x0, 0x0, 0x3, 0x7, 0x2, 0x0, 0x0, 0x0, 0x0,


};

const unsigned char custom_num_12X16[10][24] = {
0x0, 0xe0, 0xf0, 0x38, 0x8, 0x0, 0x8, 0x18, 0x18, 0xf0, 0xe0, 0x80,
0x0, 0xf, 0x1f, 0x18, 0x10, 0x30, 0x30, 0x10, 0x10, 0x1f, 0x7, 0x3,

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0x0, 0x0, 0x0, 0x0, 0x70, 0xff, 0xff, 0x87, 0x0, 0x0, 0x0, 0x0,
};



long map(long x, long in_min, long in_max, long out_min, long out_max) {
  return (x - in_min) * (out_max - out_min) / (in_max - in_min) + out_min;
}

void OLED_ShowCustomNum(int16_t X, int16_t Y, int n)
{
	if (n < 10)
	{
		OLED_ShowImage(X, Y, 12, 16, custom_num_12X16[n]);
	}
	else if (n >= 10 && n < 100)
	{
		OLED_ShowImage(X-12, Y, 12, 16, custom_num_12X16[n/10]);
		OLED_ShowImage(X, Y, 12, 16, custom_num_12X16[n%10]);
	}
	else if (n < 999)
	{
		OLED_ShowImage(X-24, Y, 12, 16, custom_num_12X16[n/100]);
		OLED_ShowImage(X-12, Y, 12, 16, custom_num_12X16[n/10%10]);
		OLED_ShowImage(X, Y, 12, 16, custom_num_12X16[n%10]);
	}
}

/* USER CODE END 0 */

/**
  * @brief  The application entry point.
  * @retval int
  */
int main(void)
{
  /* USER CODE BEGIN 1 */
	int battery_fill_perc = 0; // battery fill percentage 0-100%
	int anim_frame = 0; // animation frame for the blob / metaballs animation

	int xoff = 29;//0;//29;   // x offset for the battery
	int yoff = 12;//0;//24;   // y offset for the battery
  /* USER CODE END 1 */

  /* MCU Configuration--------------------------------------------------------*/

  /* Reset of all peripherals, Initializes the Flash interface and the Systick. */
  HAL_Init();

  /* USER CODE BEGIN Init */

  /* USER CODE END Init */

  /* Configure the system clock */
  SystemClock_Config();

  /* USER CODE BEGIN SysInit */

  /* USER CODE END SysInit */

  /* Initialize all configured peripherals */
  MX_GPIO_Init();
  /* USER CODE BEGIN 2 */
  OLED_Init();
  /* USER CODE END 2 */

  /* Infinite loop */

  int num_pos_x = 64;

#if MODE == 0
  xoff = 29;
  yoff = 0;
  int real_battery_fill_perc = 0;
  while(1) {
	  if (battery_fill_perc == 0) {
		  OLED_ShowImage(xoff, yoff, 70, 40, battery_outline);
		  OLED_Update();
	  }
	  int fill_width = map(battery_fill_perc, 0, 100, 4, 61); // width of the fill rectangle
	  OLED_DrawRectangle(xoff+3, yoff+3, fill_width, 34, 1);

	  OLED_ShowImage(xoff + 3 + fill_width - 1, yoff+3, 32, 32, water_array[anim_frame]); // draw blob animation
	  OLED_UpdateArea(xoff, yoff, 64, 40);// restrict all graphics output to the specified range

	  OLED_ShowCustomNum(num_pos_x, 48, real_battery_fill_perc);
	  OLED_ShowChar(num_pos_x+12, 48, '%', OLED_6X8);

	  OLED_UpdateArea(num_pos_x - 24, 48, 42, 16);

	  // increase battery fill percentage 0-100
	  battery_fill_perc++;
	  if (battery_fill_perc > 100) {
		  battery_fill_perc = 0;
		  real_battery_fill_perc ++;
		  OLED_Clear();

	  }
	  if (real_battery_fill_perc > 100) {
		  battery_fill_perc = 0;
		  real_battery_fill_perc = 0;
		  OLED_Clear();
		  HAL_Delay(5000);
	  }
	  // current frame for the blob animation, 0-29
	  anim_frame = (anim_frame + 1) % 30;
//	  HAL_Delay(100);
  }

#elif MODE == 1
  xoff = 29;
  yoff = 0;
  while(1) {
	  if (battery_fill_perc == 0) {
		  OLED_ShowImage(xoff, yoff, 70, 40, battery_outline);
		  OLED_Update();
	  }
	  int fill_width = map(battery_fill_perc, 0, 100, 4, 61); // width of the fill rectangle
	  OLED_DrawRectangle(xoff+3, yoff+3, fill_width, 34, 1);

	  OLED_ShowImage(xoff + 3 + fill_width - 1, yoff+3, 32, 32, water_array[anim_frame]); // draw blob animation
	  OLED_UpdateArea(xoff, yoff, 64, 40);// restrict all graphics output to the specified range

	  OLED_ShowCustomNum(num_pos_x, 48, battery_fill_perc);
	  OLED_ShowChar(num_pos_x+12, 48, '%', OLED_6X8);
	  OLED_UpdateArea(num_pos_x - 24, 48, 42, 16);

	  // increase battery fill percentage 0-100
	  battery_fill_perc++;
	  if (battery_fill_perc > 100) {
		  battery_fill_perc = 0;
		  OLED_Clear();
		  HAL_Delay(5000);
	  }

	  // current frame for the blob animation, 0-29
	  anim_frame = (anim_frame + 1) % 30;
	  HAL_Delay(100);
  }
#else
  xoff = 29;//0;//29;   // x offset for the battery
  yoff = 12;//0;//24;   // y offset for the battery
  while (1)
  {
	  if (battery_fill_perc == 0) {
		  OLED_ShowImage(xoff, yoff, 70, 40, battery_outline);
		  OLED_Update();
	  }
	  int fill_width = map(battery_fill_perc, 0, 100, 4, 61); // width of the fill rectangle
	  OLED_DrawRectangle(xoff+3, yoff+3, fill_width, 34, 1);

	  OLED_ShowImage(xoff + 3 + fill_width - 1, yoff+3, 32, 32, water_array[anim_frame]); // draw blob animation
	  OLED_UpdateArea(xoff, yoff, 64, 40);// restrict all graphics output to the specified range


	  // increase battery fill percentage 0-100
	  battery_fill_perc++;
	  if (battery_fill_perc > 100) {
		  battery_fill_perc = 0;
		  OLED_Clear();
	  }

	  // current frame for the blob animation, 0-29
	  anim_frame = (anim_frame + 1) % 30;
    /* USER CODE END WHILE */

    /* USER CODE BEGIN 3 */
  }
#endif
  /* USER CODE END 3 */
}

/**
  * @brief System Clock Configuration
  * @retval None
  */
void SystemClock_Config(void)
{
  RCC_OscInitTypeDef RCC_OscInitStruct = {0};
  RCC_ClkInitTypeDef RCC_ClkInitStruct = {0};

  /** Initializes the RCC Oscillators according to the specified parameters
  * in the RCC_OscInitTypeDef structure.
  */
  RCC_OscInitStruct.OscillatorType = RCC_OSCILLATORTYPE_HSE;
  RCC_OscInitStruct.HSEState = RCC_HSE_ON;
  RCC_OscInitStruct.HSEPredivValue = RCC_HSE_PREDIV_DIV1;
  RCC_OscInitStruct.HSIState = RCC_HSI_ON;
  RCC_OscInitStruct.PLL.PLLState = RCC_PLL_ON;
  RCC_OscInitStruct.PLL.PLLSource = RCC_PLLSOURCE_HSE;
  RCC_OscInitStruct.PLL.PLLMUL = RCC_PLL_MUL9;
  if (HAL_RCC_OscConfig(&RCC_OscInitStruct) != HAL_OK)
  {
    Error_Handler();
  }

  /** Initializes the CPU, AHB and APB buses clocks
  */
  RCC_ClkInitStruct.ClockType = RCC_CLOCKTYPE_HCLK|RCC_CLOCKTYPE_SYSCLK
                              |RCC_CLOCKTYPE_PCLK1|RCC_CLOCKTYPE_PCLK2;
  RCC_ClkInitStruct.SYSCLKSource = RCC_SYSCLKSOURCE_PLLCLK;
  RCC_ClkInitStruct.AHBCLKDivider = RCC_SYSCLK_DIV1;
  RCC_ClkInitStruct.APB1CLKDivider = RCC_HCLK_DIV2;
  RCC_ClkInitStruct.APB2CLKDivider = RCC_HCLK_DIV1;

  if (HAL_RCC_ClockConfig(&RCC_ClkInitStruct, FLASH_LATENCY_2) != HAL_OK)
  {
    Error_Handler();
  }
}

/* USER CODE BEGIN 4 */

/* USER CODE END 4 */

/**
  * @brief  This function is executed in case of error occurrence.
  * @retval None
  */
void Error_Handler(void)
{
  /* USER CODE BEGIN Error_Handler_Debug */
  /* User can add his own implementation to report the HAL error return state */
  __disable_irq();
  while (1)
  {
  }
  /* USER CODE END Error_Handler_Debug */
}

#ifdef  USE_FULL_ASSERT
/**
  * @brief  Reports the name of the source file and the source line number
  *         where the assert_param error has occurred.
  * @param  file: pointer to the source file name
  * @param  line: assert_param error line source number
  * @retval None
  */
void assert_failed(uint8_t *file, uint32_t line)
{
  /* USER CODE BEGIN 6 */
  /* User can add his own implementation to report the file name and line number,
     ex: printf("Wrong parameters value: file %s on line %d\r\n", file, line) */
  /* USER CODE END 6 */
}
#endif /* USE_FULL_ASSERT */
